## services/esp32/sdkconfig.defaults.esp32
```kconfig
#
# ESP32 (classic) build overrides for Switch Pro BT classic HID mode.
# This env is built with framework = arduino, espidf so these settings
# are applied at build time (unlike Arduino-only prebuilt SDK blobs).
#

CONFIG_BT_ENABLED=y
CONFIG_BT_BLUEDROID_ENABLED=y
CONFIG_BT_CLASSIC_ENABLED=y
CONFIG_BT_SSP_ENABLED=y
CONFIG_BT_BLE_ENABLED=y
CONFIG_BT_HID_ENABLED=y
CONFIG_BTDM_CTRL_MODE_BTDM=y
CONFIG_FREERTOS_HZ=1000
```
